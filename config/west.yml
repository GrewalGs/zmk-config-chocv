## config/west.yml
```yaml
manifest:
  remotes:
    - name: zmkfirmware
      url-base: https://github.com/zmkfirmware
    - name: brickbots
      url-base: https://github.com/brickbots
  projects:
    - name: zmk
      remote: zmkfirmware
      revision: v0.3
      import: app/west.yml
    - name: chocV
      remote: brickbots
      revision: main
      path: modules/chocV
  self:
    path: config
```
